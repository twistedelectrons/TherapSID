#include "globals.h"
#include "sid.h"
#include "lfo.h"
#include "leds.h"
#include "isr.h"

static int presetScrollTimer;
static int envCounter;
static int lfoCounter[3];
static int env2;

const int envMap[] = {
    0,   0,   0,   0,   0,   0,   0,   0,   0,   0,   0,   0,   0,   0,   0,   0,   0,   0,   0,   0,   0,   0,   0,
    0,   0,   0,   0,   0,   0,   0,   0,   0,   0,   0,   0,   0,   0,   0,   0,   0,   0,   0,   0,   0,   0,   0,
    0,   0,   0,   0,   0,   0,   0,   0,   0,   0,   0,   0,   0,   0,   0,   0,   0,   0,   0,   0,   0,   0,   0,
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    340, 341, 342, 343, 344, 345, 346, 347, 349, 350, 351, 352,
};

const int envMap2[] = {
    0,    0,    0,    0,    0,    0,    0,    0,    0,    0,    0,    0,    0,    0,    0,    0,    0,    0,    0,
    0,    0,    0,    0,    0,    0,    0,    0,    0,    0,    0,    0,    0,    0,    0,    0,    0,    0,    0,
    0,    0,    0,    0,    0,    0,    0,    0,    1,    1,    1,    1,    1,    1,    1,    1,    1,    1,    1,
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    2091, 2098, 2105, 2112, 2119, 2126, 2133, 2139, 2146, 2153, 2160, 2167, 2174, 2181, 2188, 2195, 2202,
};

// interrupt service route to animate things (LFO arp etc)
// called at 10kHz frequency (probably slower) // FIXME figure out the actual frequency.
void isr() {

	if (shape1Pressed) {
		shape1PressedTimer++;
	}

	if (resetDown) {
		resetDownTimer++;
		if (resetDownTimer > 16000) {
			resetDown = 0;
			resetDownTimer = 0;
			jumble = 1;
		}
	}

	// ENV
	switch (envState) {
		case 1:
			if (a4 == 0) { // FIXME get rid of a4
				env = 255;
				envState = 2;
			} else {
				envCounter++;
				if (envCounter >= envMap[a4]) {
					envCounter = 0;
					env += 1;
					if (env > 255) {
						env = 255;
						envState = 2;
					}
				}
			}
			break; // ATTACK
		case 2:
			if (d4 == 0) {
				env = s4;
				envState = 3;
			}
			envCounter++;
			if (envCounter >= envMap[d4]) {
				envCounter = 0;
				env -= 1;
				if (env < s4) {
					env = s4;
					envState = 3;
				}
			}
			break; // DECAY
		case 3:
			env = s4;
			env2 = 255;
			break; // SUSTAIN
		case 4:
			envCounter++;
			if (envCounter >= envMap2[r4]) {
				envCounter = 0;
				env2 -= 1;
				env = map(env2, 255, 0, s4, 0);
				if (env2 < 1) {
					env = 0;
					envState = 0;
				}
			}
			break; // RELEASE
	}

	if (loadTimer)
		loadTimer--;

	if (filterModeHeld) {
		arpModeCounter++;
		if (arpModeCounter > 25000) {
			fatChanged = true;
			arpModeCounter = 0;
			preset_data.fat_mode = static_cast<FatMode>(((int)preset_data.fat_mode + 1) % 4);
			fatShow = true;
		}
	}

	/* FIXME: redo CV/gate functionality
	// cvGate
	gate = (PINA & _BV(7)) == 0;
	if (gate != gateLast) {
		gateLast = gate;
		bitWrite(sid[4], 0, gate);
		bitWrite(sid[11], 0, gate);
		bitWrite(sid[18], 0, gate);
		held = 0;
	}
	*/

	if (saveMode) {
		saveModeTimer++;
	}

	if (!sync) {
		// ARP
		if (preset_data.arp_mode && arping && voice_state.n_held_keys() > 0) {
			arpCounter++;
		}
	}
	if (presetUp || presetDown) {
		if (presetUp && !presetDown) {
			presetScrollTimer += 4;
			if (presetScrollTimer > presetScrollSpeed) {
				presetScrollTimer = 0;
				if (presetScrollSpeed > 1001) {
					presetScrollSpeed -= 1000;
				}
				preset++;
				if (preset > 99) {
					preset = 1;
				}
				showPresetNumber = true;
				scrolled = true;
			}
		} else if (!presetUp && presetDown) {
			presetScrollTimer += 4;
			if (presetScrollTimer > presetScrollSpeed) {
				presetScrollTimer = 0;
				if (presetScrollSpeed > 1001) {
					presetScrollSpeed -= 1000;
				}
				preset--;
				if (preset < 1) {
					preset = 99;
				}
				showPresetNumber = true;
				scrolled = true;
			}
		}
	}

	if (lfoButtPressed) {
		lfoButtTimer++;
		if (lfoButtTimer == 6000) {
			clearLfo();
			lfoButtTimer = 0;
			lfoButtPressed = false;
		}
	} // delete LFO stuff

	// glides

	// in monophonic mode, we glide only while the old note is still held down.
	bool skip_glide = !preset_data.paraphonic && voice_state.n_held_keys() <= 1;
	for (int i=0; i<6; i++) {
		int voice_idx = preset_data.paraphonic ? 0 : (i % 3); // FIXME this is not nice
		glide[i].glide_tick(skip_glide ? 0 : preset_data.voice[voice_idx].glide);
	}


	// LFO
	for (int i = 0; i < 3; i++) {
		if (!sync) {
			lfoCounter[i] += lfoSpeed[i];
			if (lfoCounter[i] >= 4000) {
				lfoCounter[i] -= 4000;
				lfoStep[i]++;

				if (lfoStep[i] > 254) {
					if (preset_data.lfo[i].looping) {
						lfoStep[i] = 0;
					} else {
						lfoStep[i] = 255;
					}
				}
			}
		}
	}
}
